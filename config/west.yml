## config/west.yml
```yaml
manifest:
  remotes:
    - name: varVanse
      url-base: https://github.com/varVanse
  projects:
    - name: zmk
      remote: varVanse
      revision: main
      import: app/west.yml
  self:
    path: config
```
